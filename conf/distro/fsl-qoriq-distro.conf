## conf/machine/include/qoriq-wks-base.inc
```bitbake
require conf/machine/include/utilities.inc

# short-description: Create eMMC/SD card image with a boot partition
#
# Offsets:
#   * RCW+PBI+BL2 at block 8
#   * PFE firmware at block 0x100
#   * FIP (BL31+BL32+BL33) at 0x800
#   * Env variables at 0x2800
#   * Secureboot headers at 0x3000
#   * DDR PHY FIP at 0x4000
#   * DPAA1 FMAN ucode at 0x4800
#   * DPAA2-MC at 0x5000
#   * DPAA2 DPL at 0x6800
#   * DPAA2 DPC at 0x7000
#   * Device tree (UEFI) at 0x7800
#   * Kernel at 0x8000
#   * Ramdisk at 0x10000
#
# The disk layout (in blocks) used is:
#  blocks                           KiB
#     0x0 +-----------------------+    0x0
#         | MBR / GPT ...         |
#     0x8 +-----------------------+    0x4
#         | RCW + PBI + BL2       |
#   0x100 +-----------------------+   0x80
#         | PFE firmware          |
#   0x800 +-----------------------+  0x400
#         | FIP (BL31+BL32+BL33)  |
#  0x2800 +-----------------------+ 0x1400
#         | U-Boot Env variables  |
#  0x3000 +-----------------------+ 0x1800
#         | Secureboot headers    |
#  0x4000 +-----------------------+ 0x2000
#         | DDR PHY FIP           |
#  0x4800 +-----------------------+ 0x2400
#         | DPAA1 FMAN ucode      |
#  0x5000 +-----------------------+ 0x2800
#         | DPAA2-MC              |
#  0x6800 +-----------------------+ 0x3400
#         | DPAA2 DPL             |
#  0x7000 +-----------------------+ 0x3800
#         | DPAA2 DPC             |
#  0x7800 +-----------------------+ 0x3c00
#         | Device tree (UEFI)    |
#  0x8000 +-----------------------+ 0x4000
#         | Kernel                |
# 0x10000 +-----------------------+ 0x8000
#         | Ramdisk               |
#         +-----------------------+
#

# offset(1K) number in beginning 64MB space of SD/eMMC card on all QorIQ platforms

SD_PBL_OFFSET  ?= "4"
SD_FIP_OFFSET  ?= "1024"
SD_UBOOT_ENV_OFFSET  ?= "5120"
SD_SECUREBOOT_HEADERS_OFFSET  ?= "6144"
SD_DDR_PHY_FW_OFFSET  ?= "8192"
SD_FUSE_HEADERS_OFFSET  ?= "8704"
SD_FMAN_UCODE_OFFSET  ?= "9216"
SD_QE_DP_FW_OFFSET  ?= "9472"
SD_ETH_PHY_FW_OFFSET  ?= "9728"
SD_UBOOT_SCR_OFFSET  ?= "9984"
SD_DPAA2_MC_FW_OFFSET  ?= "10240"
SD_DPAA2_MC_DPL_OFFSET  ?= "13312"
SD_DPAA2_MC_DPC_OFFSET  ?= "14336"
SD_DEVICE_TREE_OFFSET  ?= "15360"
SD_KERNEL_OFFSET  ?= "16384"
SD_KERNELITB_OFFSET  ?= "16384"
SD_RAMDISKRFS_OFFSET  ?= "17408"

# offset(1K) number in beginning 64MB space of QSPI/XSPI/NAND flash on all QorIQ platforms

FLASH_PBL_OFFSET  ?= "0"
FLASH_FIP_OFFSET  ?= "1024"
FLASH_UBOOT_ENV_OFFSET  ?= "5120"
FLASH_SECUREBOOT_HEADERS_OFFSET  ?= "6144"
FLASH_DDR_PHY_FW_OFFSET  ?= "8192"
FLASH_FUSE_HEADERS_OFFSET  ?= "8704"
FLASH_FMAN_UCODE_OFFSET  ?= "9216"
FLASH_QE_DP_FW_OFFSET  ?= "9472"
FLASH_ETH_PHY_FW_OFFSET  ?= "9728"
FLASH_UBOOT_SCR_OFFSET  ?= "9984"
FLASH_PFE_OFFSET ?= "10240"
FLASH_DPAA2_MC_FW_OFFSET  ?= "10240"
FLASH_DPAA2_MC_DPL_OFFSET  ?= "13312"
FLASH_DPAA2_MC_DPC_OFFSET  ?= "14336"
FLASH_DEVICE_TREE_OFFSET  ?= "15360"
FLASH_KERNEL_OFFSET  ?= "16384"
FLASH_KERNELITB_OFFSET  ?= "16384"
FLASH_RAMDISKRFS_OFFSET  ?= "17408"

# Defaualt Firmware setting
PBL_FILE ?= "atf/bl2_sd.pbl"
FIP_FILE ?= "atf/fip_uboot.bin"
DDR_PHY_FILE ?= ""
QE_DP_FILE ?= ""
FMAN_UCODE_FILE ?= ""
ETH_PHY_FILE ?= ""
PFE_FILE ?= ""
MCFW_FILE ?= ""
DPL_FILE ?= ""
DPC_FILE ?= ""
ITB_FILE ?= "fitImage"

WKS_FILE ?= ""

# lx2160a
DDR_PHY_FILE:lx2160a ?= "ddr-phy/fip_ddr_all.bin"
ETH_PHY_FILE:lx2160a ?= "inphi/in112525-phy-ucode.txt"
MCFW_FILE:lx2160a ?= "mc_app/mc.itb"
DPL_FILE:lx2160a ?= "mc-utils/dpl-eth.19.dtb"
DPC_FILE:lx2160a ?= "mc-utils/dpc-usxgmii.dtb"

WKS_FILE:lx2160a ?= "qoriq-lx2160a.wks.in"

# ls1043a
FMAN_UCODE_FILE:ls1043a ?= "fsl_fman_ucode_ls1043_r1.1_108_4_9.bin"
ETH_PHY_FILE:ls1043a ?= "ls2-phy/cs4315-cs4340-PHY-ucode.txt"

WKS_FILE:ls1043a ?= "qoriq-ls104xa.wks.in"


# ls1046a
FMAN_UCODE_FILE:ls1046a ?= "fsl_fman_ucode_ls1046_r1.0_106_4_18.bin"
ETH_PHY_FILE:ls1046a ?= "ls2-phy/cs4315-cs4340-PHY-ucode.txt"

WKS_FILE:ls1046a ?= "qoriq-ls104xa.wks.in"

# ls1028a
QE_DP_FILE:ls1028a ?= "dp/ls1028a-dp-fw.bin"

WKS_FILE:ls1028a ?= "qoriq-ls1028a.wks.in"

# ls102xa
QE_DP_FILE:ls102xa ?= "boot/iram_Type_A_LS1021a_r1.0.bin"
WKS_FILE:ls102xa ?= "qoriq-ls102xa.wks.in"

# ls1021atwr
RCW_FILE:ls1021atwr = "rcw/ls1021atwr/SSR_PNS_30/rcw_1200_sdboot.bin"
UBOOT_FILE:ls1021atwr = "u-boot.bin-sdcard-qspi"

# ls1021atsn
RCW_FILE:ls1021atsn = "rcw/ls1021atsn/SSR_PNS_30/rcw_1200_sdboot.bin"
UBOOT_FILE:ls1021atsn = "u-boot.bin-sdcard"

# ls1021aiot
UBOOT_FILE:ls1021aiot ?= "${@bb.utils.contains('DISTRO_FEATURES', \
                          'baremetal', \
                          'u-boot.bin', \
                          'u-boot.bin-sdcard', d)}"
WKS_FILE:ls1021aiot ?= "qoriq-ls1021aiot.wks.in"

# ls1012a
FLASH_PFE_OFFSET:ls1012afrwy ?= "128"
FLASH_FIP_OFFSET:ls1012afrwy ?= "384"

PBL_FILE:ls1012a ?= "atf/bl2_qspi.pbl"
PFE_FILE:ls1012a ?= "engine-pfe-bin/pfe_fw_sbl.itb"

WKS_FILE:ls1012a ?= "qoriq-ls1012a.wks.in"

# Do not update fstab file when using wic images
# WIC_CREATE_EXTRA_ARGS ?= "--no-fstab-update"

IMAGE_BOOT_FILES ?= " \
    ${KERNEL_IMAGETYPE} \
    ${@make_dtb_boot_files(d)} \
"

DISTRO_BOOT_SCR_FILE ?= "${MACHINE}_boot.scr"
DISTRO_BOOT_SCR_FILE:lx2160ardb-rev2 ?= "lx2160ardb_boot.scr"

IMAGE_BOOT_FILES:append = " ${DISTRO_BOOT_SCR_FILE}"
WKS_FILE_DEPENDS:append = " u-boot-script-distroboot"

IMAGE_BOOT_FILES:remove:ls1012a = " ${DISTRO_BOOT_SCR_FILE}"
WKS_FILE_DEPENDS:remove:ls1012a = " u-boot-script-distroboot"
```

## conf/machine/include/ubuntubasics.inc
```bitbake
# We currently support recipies for:
# - 16.04.5
# - 18.04.3
#UBUNTU_TARGET_VERSION ?= "16.04.5"
#UBUNTU_TARGET_VERSION ?= "18.04.3"
UBUNTU_TARGET_VERSION ?= "20.04"

UBUNTU_TARGET_MAJORVERSION ?= "${@d.getVar('UBUNTU_TARGET_VERSION', True).rsplit('.')[0]}"
UBUNTU_TARGET_MINORVERSION ?= "${@d.getVar('UBUNTU_TARGET_VERSION', True).rsplit('.')[1]}"
UBUNTU_TARGET_SUBVERSION ?= "${@d.getVar('UBUNTU_TARGET_VERSION', True).rsplit('.')[2]}"
UBUNTU_TARGET_BASEVERSION ?= "${UBUNTU_TARGET_MAJORVERSION}.${UBUNTU_TARGET_MINORVERSION}"
PREFERRED_VERSION_ubuntu-base = "${UBUNTU_TARGET_VERSION}"

# I am sure there are smarter ways to map the architecture. This works
# initially. FIX
UBUNTU_TARGET_ARCH="${@d.getVar('TRANSLATED_TARGET_ARCH', True).replace("aarch64", "arm64")}"

# Downconfigure Yocto environment to not pull in local things
# We do not want any default post intercepts or special default
# packages added.
IMAGE_LINGUAS = ""
POKY_DEFAULT_EXTRA_RDEPENDS_remove = "packagegroup-core-boot"
INITRAMFS_IMAGE = ""
POSTINST_INTERCEPTS_DIR = "<--InVaLiD-->"

# The Yocto glibc version must not exceed the Desktop glibc version
# or Yocto-created executables will fail on the Desktop image.
# We want to be as close as possible to the respective Desktop glibc
# version to avoid compatibility issues.
# The glibc version for a given Desktop release is a-priori knowledge,
# so the suitable Yocto version can be selected here.
# Note that the glibc is not compiled in Desktop identical fashion.
# It remains a glibc that works for Yocto, which is good enough for
# our purposes.
# Desktop 16.04: max glibc 2.23...
# Desktop 18.04: max glibc 2.27...
# Desktop 20.x: max glibc 2.31...
GLIBCVERSION = '${@ \
    oe.utils.conditional("UBUNTU_TARGET_BASEVERSION", "16.04", "2.23", \
    oe.utils.conditional("UBUNTU_TARGET_BASEVERSION", "18.04", "2.27", \
    oe.utils.conditional("UBUNTU_TARGET_BASEVERSION", "20.04", "2.31%", \
    "unsupportedubuntuversion" \
    , d) \
    , d) \
    , d)}'
PREFERRED_VERSION_cross-localedef-native = "${GLIBCVERSION}"
BINUVERSION="2.34"

# More recent Desktop versions work with symlinks for the base
# directories. We can't refer to symlink based files
DISTRO_FEATURES_append = '${@ \
    oe.utils.conditional("UBUNTU_TARGET_BASEVERSION", "16.04", "", \
    oe.utils.conditional("UBUNTU_TARGET_BASEVERSION", "18.04", "", \
    oe.utils.conditional("UBUNTU_TARGET_BASEVERSION", "20.04", " usrmerge", \
   "unsupportedubuntuversion" \
    , d) \
    , d) \
    , d)}'

PREFERRED_PROVIDER_bison-native = "bison"

# This is to be able to pull in the prebuilt Desktop rootfs
MACHINEOVERRIDES =. "ubuntu:"

# When creating images, we would like to preserve any extended
# attributes that are part of our rootfs
IMAGE_CMD_TAR = "tar --xattrs --xattrs-include=*"
do_image_tar[depends] += "tar-replacement-native:do_populate_sysroot"
EXTRANATIVEPATH += "tar-native"

# We influence the setup to match Desktop more properly as otherwise
# Yocto behavior may conflict with the Desktop rootfs.
INIT_MANAGER = "systemd"

# Turns out that we want the Yocto recipes as default provider, but
# then we must ensure they do not get deployed to avoid pollution of
# the target rootfs.
# Rationale is that Yocto builds need to be internally consistent,
# and we need the sysroots info for Yocto recipes, but the Desktop rootfs
# provides things, too. We can't use that for building though, so Yocto
# packages conflicting must not reach the package manager.
# Whenever a Yocto package is installed, all dependencies which are
# to be provided by Desktop must be added to the list. Check
# recipe-depends.dot from bitbake -g.
# The respective Desktop image must then install the Desktop version of
# the recipe.
require conf/machine/include/nodistropackage.inc
DISTRO_NEVER_WRITE_PACKAGE_class-target += "\
    alsa-conf \
    alsa-lib \
    update-alternatives \
    bash \
    base-files \
    bc \
    bison \
    bluez5 \
    bzip2 \
    ca-certificates \
    coreutils \
    db \
    diffutils \
    dpkg \
    dtc \
    flex \
    glibc \
    glibc-locale \
    gcc-runtime \
    gdbm \
    initscripts \
    libc6 \
    libc6-utils \
    libffi \
    libgcc \
    liblzma \
    libpam \
    libsqlite3 \
    libxml2 \
    m4 \
    ncurses \
    netbase \
    opkg-utils \
    perl \
    python3 \
    qemuwrapper-cross \
    shared-mime-info \
    sqlite3 \
    readline \
    util-linux \
    xz \
    zlib \
"

# We have some packages which we do not want to have in a target
# image because they are available as Desktop-native packages.
# Given that we can't set a PREFERRED_RPROVIDER in an image recipe
# we need to isolate those packages globally.
DISTRO_NEVER_WRITE_PACKAGE_class-target += "\
    openssl \
    openssl-bin \
    openssl-conf \
    openssl-dev \
"

# All the runtime above should come from ubuntu-base or a derived image
# but only for the target, not for native elements.
# The trick is that we need to retarget everything to one recipe because
# at configuration time we cannot predict algorithmically which derived
# images would add the final apt packages. Any "missing" dependencies
# would only show up then at image build time.
DISTRO_DEFAULT_RPROVIDER_class-target = "ubuntu-base (= ${UBUNTU_TARGET_VERSION})"
```

## conf/machine/ls1012afrwydistro.conf
```bitbake
MACHINE="ls1012afrwy"
require conf/machine/ls1012afrwy.conf

require conf/machine/include/ubuntubasics.inc

HOSTTOOLS_NONFATAL:append = " bc"
```

## conf/machine/ls1012ardbdistro.conf
```bitbake
MACHINE="ls1012ardb"
require conf/machine/ls1012ardb.conf

require conf/machine/include/ubuntubasics.inc
```

## conf/machine/ls1021atwrdistro.conf
```bitbake
MACHINE="ls1021atwr"
require conf/machine/ls1021atwr.conf

require conf/machine/include/ubuntubasics.inc

APTGET_TARGET_ARCH:ls1021atwr = "armhf"
UBUNTU_TARGET_ARCH:ls1021atwr = "armhf"
```

## conf/machine/ls1028ardbdistro.conf
```bitbake
MACHINE="ls1028ardb"
require conf/machine/ls1028ardb.conf

require conf/machine/include/ubuntubasics.inc
```

## conf/machine/ls1043ardbdistro.conf
```bitbake
MACHINE="ls1043ardb"
require conf/machine/ls1043ardb.conf

require conf/machine/include/ubuntubasics.inc

require conf/machine/include/layerscape-composite-memory-map.inc
HOSTTOOLS_NONFATAL:append = " bc"
BOOT_TYPE = "sd nor nand"
BOOTLOADER_TYPE = "uboot uefi"

export COMPOSITE_IMG1_FILE_sd       = "atf/bl2_sd.pbl"
export COMPOSITE_IMG1_FILE_sd_sec   = "atf/bl2_sd_sec.pbl"
export COMPOSITE_IMG1_FILE_nor      = "atf/bl2_nor.pbl"
export COMPOSITE_IMG1_FILE_nor_sec  = "atf/bl2_nor_sec.pbl"
export COMPOSITE_IMG1_FILE_nand     = "atf/bl2_nand.pbl"
export COMPOSITE_IMG1_FILE_nand_sec = "atf/bl2_nand_sec.pbl"
export COMPOSITE_IMG2_FILE          = "atf/fip_uboot.bin"
export COMPOSITE_IMG2_FILE_sec      = "atf/fip_uboot_sec.bin"
export COMPOSITE_IMG2_FILE_uefi     = "atf/fip_uefi.bin"
export COMPOSITE_IMG3_FILE_uefi     = "uefi/ls1043ardb/LS1043ARDBNV_EFI_NORBOOT.fd"
export COMPOSITE_IMG4_FILE_sd_sec   = "secboot_hdrs/secboot_hdrs_sdboot.bin"
export COMPOSITE_IMG4_FILE_nor_sec  = "secboot_hdrs/secboot_hdrs_norboot.bin"
export COMPOSITE_IMG7_FILE          = "fsl_fman_ucode_ls1043_r1.1_106_4_18.bin"
export COMPOSITE_IMG8_FILE          = "boot/iram_Type_A_LS1021a_r1.0.bin"
export COMPOSITE_IMG9_FILE          = "ls2-phy/cs4315-cs4340-PHY-ucode.txt"
export COMPOSITE_IMG14_FILE         = "fsl-ls1043a-rdb-sdk.dtb"

distro_boot_script ?= "\
  env exists dtb || setenv dtb fsl-ls1043a-rdb-sdk.dtb; \
  env exists kernel_image || setenv kernel_image Image; \
  env exists devpart_boot || setenv devpart_boot 1; \
  env exists devpart_root || setenv devpart_root 4; \
  part uuid \$devtype \$devnum:\$devpart_root partuuidr; \
  setenv bootargs console=ttyS0,115200 earlycon=uart8250,mmio,0x21c0500 root=PARTUUID=\$partuuidr rw rootwait \$othbootargs; \
  load \$devtype \$devnum:\$devpart_root \$kernel_addr_r boot/\$kernel_image; \
  load \$devtype \$devnum:\$devpart_root \$fdt_addr_r boot/\$dtb; \
  env exists secureboot && echo validating secureboot && run secureboot_validate; \
  booti \$kernel_addr_r - \$fdt_addr_r"
```

## conf/machine/ls1046afrwydistro.conf
```bitbake
MACHINE="ls1046afrwy"
require conf/machine/ls1046afrwy.conf

require conf/machine/include/ubuntubasics.inc
```

## conf/machine/ls1046ardbdistro.conf
```bitbake
MACHINE="ls1046ardb"
require conf/machine/ls1046ardb.conf

require conf/machine/include/ubuntubasics.inc
```

## conf/machine/ls1088ardbdistro.conf
```bitbake
MACHINE="ls1088ardb"
require conf/machine/ls1088ardb.conf

require conf/machine/include/ubuntubasics.inc

HOSTTOOLS_NONFATAL:append = " bc"
```

## conf/machine/ls2088ardbdistro.conf
```bitbake
MACHINE="ls2088ardb"
require conf/machine/ls2088ardb.conf

require conf/machine/include/ubuntubasics.inc
```

## conf/machine/lx2160ardb-rev2distro.conf
```bitbake
MACHINE="lx2160ardb-rev2"
require conf/machine/lx2160ardb-rev2.conf

require conf/machine/include/ubuntubasics.inc
```
