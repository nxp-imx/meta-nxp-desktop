## conf/distro/fsl-qoriq-distro.conf
```bitbake
#require conf/distro/fsl-qoriq.conf
require conf/distro/poky.conf
include conf/machine/include/qoriq-wks-base.inc

DISTRO = "fsl-qoriq-distro"
DISTRO_NAME = "QorIQ SDK POC (Proof of Concept)"
MAINTAINER = "Freescale Yocto Team <meta-freescale@yoctoproject.org>"

TARGET_VENDOR = "-fsl"

SDK_VENDOR = "-fslsdk"
SDK_NAME_PREFIX = "${DISTRO}"

BBMASK += "recipes-libraries/nnstreamer/"
BBMASK += "recipes-graphics/libgpuperfcnt/"
BBMASK += "recipes-bsp/imx-vpu-hantro-vc/"

DISTRO_FEATURES:append = " security"
DISTRO_FEATURES_DEFAULT:remove = "x11"
POKY_DEFAULT_DISTRO_FEATURES:remove = " ptest opengl wayland vulkan"

DISTRO_FEATURES:append = " pam virtualization polkit ipv6"
DISTRO_FEATURES:append:ls1028a = " opengl wayland vulkan x11"
DISTRO_FEATURES_BACKFILL_CONSIDERED:append:qoriq-ppc = " gobject-introspection-data"
MACHINE_FEATURES_BACKFILL_CONSIDERED:append:e500v2 = " qemu-usermode"

LICENSE_FLAGS_ACCEPTED = "non-commercial_netperf"

PREFERRED_PROVIDER_qemu = "qemu-qoriq"

PREFERRED_VERSION_virtual/nativesdk-libiconv = "2.20"
PREFERRED_VERSION_tcpreplay = "3.4.4"
PREFERRED_PROVIDER_virtual/kernel = "linux-qoriq"
LTTNGUST:qoriq = ""
LTTNGTOOLS:qoriq = ""
LTTNGMODULES:qoriq = ""
MACHINE_HAS_VIVANTE_KERNEL_DRIVER_SUPPORT = "1"

## Overwrite weak default in meta-freescale
KERNEL_IMAGETYPE:qoriq-arm ?= "uImage"

SERIAL_CONSOLES:qoriq-arm ?= "115200;ttyS0 115200;ttyS1 115200;ttyEHV0 115200;ttyLP0 115200;ttyAMA0"
SERIAL_CONSOLES:qoriq-arm64 ?= "115200;ttyS0 115200;ttyS1 115200;ttyAMA0"
FSL_EULA_FILE_MD5SUM_LA_OPT_NXP_SOFTWARE_LICENSE_V35 = "d3c315c6eaa43e07d8c130dc3a04a011"

FSL_EULA_FILE_MD5SUMS:append = " \
    ${FSL_EULA_FILE_MD5SUM_LA_OPT_NXP_SOFTWARE_LICENSE_V35} \
"
```

## conf/distro/imx-desktop-xwayland.conf
```bitbake
include conf/distro/fsl-imx-xwayland.conf

DISTRO = "imx-desktop-xwayland"

DISTRO_NAME = "Desktop Experience BSP"
DISTRO_VERSION = "1.0"
SDK_VENDOR = "-fslbsp"

TARGET_VENDOR = "-fsl"

SDK_NAME_PREFIX = "${DISTRO}"
SDK_NAME = "${DISTRO}-${TCLIBC}-${SDK_ARCH}-${TUNE_PKGARCH}"

POKY_DEFAULT_DISTRO_FEATURES:remove = " ptest"
DISTRO_FEATURES_DEFAULT:append = " benchmark vfat ext2 mtd \
    perl python usbhost virtualization pam polkit"

# disable network check to support offline build with sdk iso
CONNECTIVITY_CHECK_URIS = ""

# whiteliste restricted license
LICENSE_FLAGS_ACCEPTED = "non-commercial_netperf commercial_lame"

#DISTRO_FEATURES_DEFAULT:append = " pam polkit"

PREFERRED_VERSION_imx-gpu-g2d = "${IMX_GPU_VERSION}"
PREFERRED_VERSION_libgpuperfcnt = "${IMX_GPU_VERSION}"
PREFERRED_VERSION_isp-imx:mx8mp-nxp-bsp = "4.2.2.20.0d"
PREFERRED_VERSION_imx-vpu-hantro-vc:mx8mp-nxp-bsp = "1.9.1d"
PREFERRED_VERSION_imx-dpu-g2d ?= "2.1.8.1d"
PREFERRED_VERSION_cheese = "41.1"

IMAGE_ROOTFS_SIZE ?= "6291456"

# UBI FS support
MKUBIFS_ARGS = "-m 512 -e 15360 -c 12000"
UBINIZE_ARGS = "-m 512 -p 16KiB -s 512"

# Having some problems with i.MX OpenCV, which is brought in by
# gstreamer1.0-plugins-bad, so disable it
PACKAGECONFIG:remove:pn-gstreamer1.0-plugins-bad = "opencv"

BBMASK += "recipes-fsl/packagegroups/packagegroup-fsl-tools-extended.bbappend"
BBMASK += "recipes-fsl/images/fsl-image-mfgtool.bbappend"

MACHINE_FEATURES:remove = "optee"
```

## conf/layer.conf
```bitbake
# We have a conf and classes directory, add to BBPATH
# Note how we PREpend BBPATH. This is due to the fact that
# bitbake does not override classes per layer as it does
# recipes. Classes are processed strictly in BBPATH order.
# As we unfortunately have to override standard classes for
# bug fixing, we prepend instead of append our path.

#This layer is a stripped down version of the AMP meta-alb layer
#meant to be used independently outside the AMP solution.
BBPATH =. "${LAYERDIR}:"

BBFILE_COLLECTIONS += "desktop-distro"
BBFILE_PATTERN_desktop-distro := "^${LAYERDIR}"
BBFILE_PRIORITY_desktop-distro = "8"

BBFILES += "${@' '.join('${LAYERDIR}/dynamic-layers/%s/recipes*/*/*.bbappend' % layer \
		for layer in BBFILE_COLLECTIONS.split())}"
BBFILES += "${@' '.join('${LAYERDIR}/dynamic-layers/%s/recipes*/*/*.bb' % layer \
		for layer in BBFILE_COLLECTIONS.split())}"

BBFILES += " \
        ${LAYERDIR}/images/*.bb* \
        ${LAYERDIR}/packagegroups/*.bb* \
        ${LAYERDIR}/recipes-*/*/*.bb \
        ${LAYERDIR}/recipes-*/*/*.bbappend \
        ${LAYERDIR}/classes/*.bb* \
"

BBMASK += "recipes-gnome/gnome-desktop/gnome-desktop3_%.bbappend"
BBMASK += "meta-freescale/recipes-graphics/gtk\+/gtk.*\.bbappend"

PREFERRED_PROVIDER_qemu = "qemu"
PREFERRED_VERSION_qemu-native = "4.2.1"
PREFERRED_VERSION_qemu = "4.2.1"

IMX_GPU_VERSION  = "6.4.3.p4.2d"
PREFERRED_VERSION_imx-gpu-viv = "${IMX_GPU_VERSION}-aarch64"

LAYERSERIES_COMPAT_desktop-distro = "hardknott honister kirkstone"

MACHINE_FEATURES:remove = "jailhouse"

FSL_BIN_MIRROR ?= "${FSL_MIRROR}"
```

## conf/machine/imx8mmevkdesktop.conf
```bitbake
MACHINE="imx8mmevk"
require conf/machine/imx8mmevk.conf

require conf/machine/include/ubuntubasics.inc
```

## conf/machine/imx8mnevkdesktop.conf
```bitbake
MACHINE="imx8mnevk"
require conf/machine/imx8mnevk.conf

require conf/machine/include/ubuntubasics.inc
```

## conf/machine/imx8mpevkdesktop.conf
```bitbake
MACHINE="imx8mpevk"
require conf/machine/imx8mpevk.conf

require conf/machine/include/ubuntubasics.inc
```

## conf/machine/imx8mqevkdesktop.conf
```bitbake
MACHINE="imx8mqevk"
require conf/machine/imx8mqevk.conf

require conf/machine/include/ubuntubasics.inc
```

## conf/machine/imx8qmmekdesktop.conf
```bitbake
MACHINE="imx8qmmek"
require conf/machine/imx8qmmek.conf

require conf/machine/include/ubuntubasics.inc
```

## conf/machine/imx8qxpc0mekdesktop.conf
```bitbake
MACHINE="imx8qxpc0mek"
require conf/machine/imx8qxpc0mek.conf

require conf/machine/include/ubuntubasics.inc
```

## conf/machine/imx8qxpmekdesktop.conf
```bitbake
MACHINE="imx8qxpmek"
require conf/machine/imx8qxpmek.conf

require conf/machine/include/ubuntubasics.inc
```

## conf/machine/imx8ulpevkdesktop.conf
```bitbake
MACHINE="imx8ulpevk"
require conf/machine/imx8ulpevk.conf

require conf/machine/include/ubuntubasics.inc

RCONFLICTS:${PN}:remove:pn-ubuntu-base:mx8ulp-nxp-bsp = "linux-firmware-nxp89xx"
RREPLACES:${PN}:remove:pn-ubuntu-base:mx8ulp-nxp-bsp = "linux-firmware-nxp89xx"
RPROVIDES:${PN}:remove:pn-ubuntu-base:mx8ulp-nxp-bsp = "linux-firmware-nxp89xx"
```

## conf/machine/include/layerscape-composite-memory-map.inc
```bitbake
# The unified 64MiB memory layout of SD/NOR/QSPI/XSPI/NAND device on all NXP QorIQ Reference boards
# see meta-freescale/docs/qoriq_memory_layout.txt

# user can customize the composite firmware in ${MACHINE}.conf by overriding the default settings 

# QorIQ supports multiple boot type: sd boot, nand boot, qspi boot, flexspi-nor(xspi) boot, ifc-nor boot
MULTI_BOOTTYPE ?= "true"

# bootloader type: uboot or uefi, some boards support both
BOOTLOADER_TYPE ?= "uboot"

# Maximum number of separate images in the composite firmware
MAX_COMPOSITE_IMG_NUM               ?= "15"

# ATF BL2 with RCW/PBL
export COMPOSITE_IMG1_OFFSET        ?= "0x00000000"
export COMPOSITE_IMG1_FILE_sd       ?= "atf/bl2_sd.pbl"
export COMPOSITE_IMG1_FILE_sd_sec   ?= ""
export COMPOSITE_IMG1_FILE_nor      ?= ""
export COMPOSITE_IMG1_FILE_nor_sec  ?= ""
export COMPOSITE_IMG1_FILE_qspi     ?= ""
export COMPOSITE_IMG1_FILE_qspi_sec ?= ""
export COMPOSITE_IMG1_FILE_xspi     ?= ""
export COMPOSITE_IMG1_FILE_xspi_sec ?= ""

# ATF BL33 with bootloader (U-Boot or UEFI)
export COMPOSITE_IMG2_OFFSET        ?= "0x00100000"
export COMPOSITE_IMG2_FILE          ?= "atf/fip_uboot.bin"
export COMPOSITE_IMG2_FILE_sec      ?= "atf/fip_uboot_sec.bin"
export COMPOSITE_IMG2_FILE_uefi     ?= ""

# Bootloader environment
export COMPOSITE_IMG3_OFFSET        ?= "0x00500000"
export COMPOSITE_IMG3_FILE          ?= ""

# Secure boot header
export COMPOSITE_IMG4_OFFSET        ?= "0x00600000"
export COMPOSITE_IMG4_FILE_sd       ?= ""
export COMPOSITE_IMG4_FILE_nor      ?= ""
export COMPOSITE_IMG4_FILE_qspi     ?= ""
export COMPOSITE_IMG4_FILE_xspi     ?= ""

# DDR PHY FW or reserved
export COMPOSITE_IMG5_OFFSET        ?= "0x00800000"
export COMPOSITE_IMG5_FILE          ?= ""

# Fuse provisioning hdr or reserved
export COMPOSITE_IMG6_OFFSET        ?= "0x00880000"
export COMPOSITE_IMG6_FILE          ?= ""
export COMPOSITE_IMG6_FILE_sec      ?= ""

# DPAA FMAN ucode or reserved
export COMPOSITE_IMG7_OFFSET        ?= "0x00900000"
export COMPOSITE_IMG7_FILE          ?= ""

# QE ucode or DP firmware
export COMPOSITE_IMG8_OFFSET        ?= "0x00940000"
export COMPOSITE_IMG8_FILE          ?= ""

# Ethernet PHY firmware             
export COMPOSITE_IMG9_OFFSET        ?= "0x00980000"
export COMPOSITE_IMG9_FILE          ?= ""

# U-boot script or reserved
export COMPOSITE_IMG10_OFFSET       ?= "0x009C0000"
export COMPOSITE_IMG10_FILE         ?= ""

# DPAA2-MC or PFE firmware
export COMPOSITE_IMG11_OFFSET       ?= "0x00A00000"
export COMPOSITE_IMG11_FILE         ?= ""

# DPAA2 DPL or reserved
export COMPOSITE_IMG12_OFFSET       ?= "0x00D00000"
export COMPOSITE_IMG12_FILE         ?= ""

# DPAA2 DPC or reserved
export COMPOSITE_IMG13_OFFSET       ?= "0x00E00000"
export COMPOSITE_IMG13_FILE         ?= ""

# Device tree dtb or reserved
export COMPOSITE_IMG14_OFFSET       ?= "0x00F00000"
export COMPOSITE_IMG14_FILE         ?= ""

# Kernel itb with tiny initramfs    
export COMPOSITE_IMG15_OFFSET       ?= "0x01000000"
export COMPOSITE_IMG15_FILE         ?= "linux_layerscape_tiny_arm64.itb"
```

## conf/machine/include/nodistropackage.inc
```bitbake
# To build foreign distro images , we do not want to deploy all Yocto
# packages, but we need their sysroot data for building other packages

# The trick really is that things like PREFERRED_PROVIDER only apply
# to the package generation. The final build step for a rootfs will
# use any package it can find unless PACKAGE_EXCLUDE is used, and
# that only works for RPM.
# Given that the ubuntu-base files already provide essential packages
# that we must not overwrite, the solution is to redirect provider use.
# We still need to build the recipes though because packages that we
# *do* want to deploy may need their header files etc.

def dnwp_checkpackagematch(d, pn, patternvar):
    import re
    for pattern in (d.getVar(patternvar) or '').split():
        pnpattern, pkglist, preferredprovider = (pattern.split(':') + 3 * [None])[:3]
        if not pnpattern:
            bb.error("Missing recipe name in nodistropackage")
        if (pn and re.match('^' + pnpattern + '$', pn)):
            if not pkglist:
                pkglist = pnpattern
            pkglist = pkglist.split(',')
            return pnpattern, pkglist, preferredprovider
    return None, None, None

def dnwp_nopackagewrites(d):
    pn = (d.getVar('PN') or '')
    foundnowritepkg, fnwpkglist, fnwprp = dnwp_checkpackagematch(d, pn, 'DISTRO_NEVER_WRITE_PACKAGE')
    foundwritepkg,   fwpkglist,  fwprp  = dnwp_checkpackagematch(d, pn, 'DISTRO_ALWAYS_WRITE_PACKAGE')
    if foundnowritepkg and not foundwritepkg:
        d.appendVar('PACKAGE_EXCLUDE:' + pn, ' ${PACKAGES}')

def dnwp_prefrprov(d):
    # This is really a workaround only, which is limiting the
    # intended flexibility of the mechanism overall. However,
    # I could not find another way to properly set the preferred
    # rprovider.
    # I wish I knew how to access all package names at that time
    # but the recipes are not parsed yet ...
    dp = d.getVar('DISTRO_DEFAULT_RPROVIDER') or ''
    dpdict = bb.utils.explode_dep_versions2(dp)
    if len(dpdict) > 1:
        bb.error("DISTRO_DEFAULT_RPROVIDER may have only one (optionally versioned) entry!")
    for dpkey, dpver in dpdict.items():
        break

    dawp = (d.getVar('DISTRO_ALWAYS_WRITE_PACKAGE') or '').split()
    for pattern in (d.getVar('DISTRO_NEVER_WRITE_PACKAGE') or '').split():
        pnpattern, packagelist, preferredrprovider = (pattern.split(':') + 3 * [None])[:3]
        if not pnpattern:
            bb.error("Missing recipe name in nodistropackage")
        if not preferredrprovider:
            preferredrprovider = dpkey
        if preferredrprovider:
            foundalwayswrite = False
            for dawpattern in dawp:
                dawpnpattern, dawpackagelist, dawpreferredrprovider = (dawpattern.split(':') + 3 * [None])[:3]
                # Note that we use pnpattern, i.e., this
                # workaround does not permit us to use real
                # pn names because we can not match against
                # the real recipe names. Hmpf.
                if (pn and re.match("^" + dawpnpattern  + "$", pnpattern)):
                    foundalwayswrite = True
                    break

            if not foundalwayswrite:
                if not packagelist:
                    packagelist = pnpattern
                packagelist = packagelist.split(',')
                for p in packagelist:
                    d.setVar('PREFERRED_RPROVIDER_' + p, preferredrprovider)

addhandler distro_never_write_package_pre
distro_never_write_package_pre[eventmask] = "bb.event.ConfigParsed"
python distro_never_write_package_pre () {
    dnwp_prefrprov(d)
}

# This is run after the keys have been expanded, i.e., we can find
# RDEPENDS_<pn> then directly for any name. The idea is that we check
# if any dependency is one that we convert to a different
# PREFERRED_RPROVIDER and fix up the RDEPENDS to avoid file-rdeps
# complaints on packaging.
def dnwp_fixuprdepends(d):
    dp = d.getVar('DISTRO_DEFAULT_RPROVIDER') or ''
    dpdict = bb.utils.explode_dep_versions2(dp)
    if len(dpdict) > 1:
        bb.error("DISTRO_DEFAULT_RPROVIDER may have only one (optionally versioned) entry!")
    for dpkey, dpver in dpdict.items():
        break

    modified = False
    for ppn in (d.getVar('PACKAGES') or '').split():
        rdepkey = 'RDEPENDS_' + ppn
        rpmodified = False
        rdepends = bb.utils.explode_dep_versions2(d.getVar(rdepkey) or '')
        newrdepends = {}
        str_rdeps = ""
        for rdep in rdepends:
            tmp_rdeps={}
            foundnordeppkg,  fnrpkglist, fnrprp = dnwp_checkpackagematch(d, rdep, 'DISTRO_NEVER_WRITE_PACKAGE')
            foundrdeppkg,    frpkglist,  frprp  = dnwp_checkpackagematch(d, rdep, 'DISTRO_ALWAYS_WRITE_PACKAGE')
            ver = rdepends[rdep]
            if foundnordeppkg and not foundrdeppkg:
                if not fnrprp:
                    fnrprp = dpkey
                    ver = dpver
                if fnrprp and fnrprp not in newrdepends:
                    rdep = fnrprp
                    rpmodified = True
                    modified = True
            newrdepends[rdep] = ver
            # add items one by one to preserve the original order
            tmp_rdeps[rdep] = ver
            str_rdeps += "%s " % bb.utils.join_deps(tmp_rdeps, commasep=False)
        if rpmodified:
            d.setVar(rdepkey, str_rdeps)

            # If we have changed the rdepends, the result is that the build
            # dependency no longer matches the redepends. This means that we
            # need to skip build-dep warnings. This is a bit ugly, but
            # it is a reasonable solution to the QA problem.
            d.appendVar('INSANE_SKIP:' +  ppn, ' build-deps')

# This is called once per package. It better be quick
python () {
    dnwp_fixuprdepends(d)
    dnwp_nopackagewrites(d)
}
```
